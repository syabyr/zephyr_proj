## CMakeLists.txt
```
# SPDX-License-Identifier: Apache-2.0

cmake_minimum_required(VERSION 3.20.0)

find_package(Zephyr REQUIRED HINTS $ENV{ZEPHYR_BASE})
project(app_usb_cdc_test)

target_sources(app PRIVATE src/main.c)
```

## prj.conf
```kconfig
CONFIG_USB_DEVICE_STACK_NEXT=y
CONFIG_SERIAL=y
CONFIG_UART_LINE_CTRL=y
CONFIG_CONSOLE=y
CONFIG_UART_CONSOLE=y
CONFIG_CDC_ACM_SERIAL_INITIALIZE_AT_BOOT=y
CONFIG_LOG=y
CONFIG_UDC_DRIVER_LOG_LEVEL_DBG=y
CONFIG_USBD_CDC_ACM_LOG_LEVEL_INF=y
CONFIG_USBD_LOG_LEVEL_INF=y

CONFIG_MAIN_STACK_SIZE=2048
CONFIG_SYSTEM_WORKQUEUE_STACK_SIZE=2048
```

## app.overlay
```dts
/*
 * Copyright (c) 2026
 *
 * SPDX-License-Identifier: Apache-2.0
 */

&zephyr_udc0 {
	cdc_acm_uart0 {
		compatible = "zephyr,cdc-acm-uart";
		label = "Tiva C USB CDC-ACM";
	};
};
```

## src/main.c
```c
/*
 * Copyright (c) 2026
 *
 * SPDX-License-Identifier: Apache-2.0
 */

#include <zephyr/kernel.h>
#include <zephyr/sys/printk.h>
#include <zephyr/usb/usbd.h>
#include <zephyr/drivers/uart.h>

/*
 * CDC ACM echo + periodic transmit test.
 * The zephyr_cdc_acm_uart0 node is created by the app.overlay.
 */

static const struct device *const cdc_dev =
	DEVICE_DT_GET_ONE(zephyr_cdc_acm_uart);

int main(void)
{
	int ret;
	uint32_t count = 0;
	unsigned char ch;

	printk("=== USB CDC ACM Test (Tiva C) ===\n");

	if (!device_is_ready(cdc_dev)) {
		printk("CDC ACM device not ready\n");
		return 0;
	}

	printk("CDC ACM device: %s\n", cdc_dev->name);

	/* Wait for the host to open the port (DTR) */
	printk("Waiting for host to open port...\n");

	while (1) {
		ret = uart_line_ctrl_get(cdc_dev, UART_LINE_CTRL_DTR, &count);
		if (ret == 0 && count != 0) {
			break;
		}
		k_sleep(K_SECONDS(1));
	}

	printk("Port opened, starting echo + beacon\n");

	/* Line coding: 115200 8N1 (virtual, informational only) */
	uart_line_ctrl_set(cdc_dev, UART_LINE_CTRL_BAUD_RATE, 115200);

	count = 0;

	while (1) {
		/* Echo any received character */
		while (uart_fifo_read(cdc_dev, &ch, 1) == 1) {
			uart_fifo_fill(cdc_dev, &ch, 1);
		}

		/* Periodic test pattern: 0x00-0x3F ramp so bit alignment
		 * errors are visible in the received stream */
		for (int i = 0; i < 64; i++) {
			uart_poll_out(cdc_dev, (unsigned char)(i & 0x3F));
		}
		count++;

		k_sleep(K_SECONDS(1));
	}

	return 0;
}
```
